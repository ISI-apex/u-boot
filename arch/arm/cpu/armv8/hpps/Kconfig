## arch/arm/cpu/armv8/hpps/Kconfig
```kconfig
if ARCH_HPSC_HPPS
config SPL_FAT_SUPPORT
	default y

config SPL_LIBCOMMON_SUPPORT
	default y

config SPL_LIBDISK_SUPPORT
	default y

config SPL_LIBGENERIC_SUPPORT
	default y

config SPL_MMC_SUPPORT
	default y if MMC_SDHCI_ZYNQ

config SPL_SERIAL_SUPPORT
	default y

config SPL_SPI_FLASH_SUPPORT
	default y if ZYNQ_QSPI

config SPL_SPI_SUPPORT
	default y if ZYNQ_QSPI

config SYS_BOARD
	default "hpps"

config SYS_VENDOR
	string "Vendor name"
	default "hpsc"

config SYS_SOC
	default "hpps"

config SYS_CONFIG_NAME
	string "Board configuration name"
	default "hpsc_hpps"
	help
	  This option contains information about board configuration name.
	  Based on this option include/configs/<CONFIG_SYS_CONFIG_NAME>.h header
	  will be used for board configuration.

config SYS_MEM_RSVD_FOR_MMU
	bool "Reserve memory for MMU Table"
	help
	  If defined this option is used to setup different space for
	  MMU table than the one which will be allocated during
	  relocation.

config BOOT_INIT_FILE
	string "boot.bin init register filename"
	depends on SPL
	default ""
	help
	  Add register writes to boot.bin format (max 256 pairs).
	  Expect a table of register-value pairs, e.g. "0x12345678 0x4321"

config PMUFW_INIT_FILE
	string "PMU firmware"
	depends on SPL
	default ""
	help
	  Include external PMUFW (Platform Management Unit FirmWare) to
	  a Xilinx bootable image (boot.bin).

config ZYNQMP_USB
	bool "Configure ZynqMP USB"

config ZYNQMP_NO_DDR
	bool "Disable DDR MMU mapping"
	help
	  This option configures MMU with no DDR to avoid speculative
	  access to DDR memory where DDR is not present.

config SYS_MALLOC_F_LEN
	default 0x600

config DEFINE_TCM_OCM_MMAP
	bool "Define TCM and OCM memory in MMU Table"
	default y if MP
	help
	  This option if enabled defines the TCM and OCM memory and its
	  memory attributes in MMU table entry.

config ZYNQMP_PSU_INIT_ENABLED
	bool "Include psu_init"
	help
	  Include psu_init to full u-boot. SPL include psu_init by default.

config BOOT_MODE_IN_RAM
	bool "BOOT_MODE_IN_RAM"
	help
	  Write bootmode in RAM area (CONFIG_BOOT_MODE_ADDRESS)

config SPL_ZYNQMP_ALT_BOOTMODE_ENABLED
	bool "Overwrite SPL bootmode"
	depends on SPL
	help
	  Overwrite bootmode selected via boot mode pins to tell SPL what should
	  be the next boot device.

config ZYNQ_SDHCI_MAX_FREQ
	default 200000000

config SPL_ZYNQMP_ALT_BOOTMODE
	hex
	default 0x0 if JTAG_MODE_HPSC
	default 0x1 if QSPI_MODE_24BIT_HPSC
	default 0x2 if QSPI_MODE_32BIT_HPSC
	default 0x3 if SD_MODE_HPSC
	default 0x4 if NAND_MODE_HPSC
	default 0x5 if SD_MODE_HPSC1
	default 0x6 if EMMC_MODE_HPSC
	default 0x7 if USB_MODE_HPSC
	default 0xa if SW_USBHOST_MODE_HPSC
	default 0xb if SW_SATA_MODE_HPSC
	default 0xe if SD1_LSHFT_MODE_HPSC
	default 0xf if BOOT_MODE_IN_RAM 

choice
	prompt "Boot mode"
	depends on SPL_ZYNQMP_ALT_BOOTMODE_ENABLED
	default JTAG_MODE_HPSC

config JTAG_MODE_HPSC
	bool "JTAG_MODE_HPSC"

config QSPI_MODE_24BIT_HPSC
	bool "QSPI_MODE_24BIT_HPSC"

config QSPI_MODE_32BIT_HPSC
	bool "QSPI_MODE_32BIT_HPSC"

config SD_MODE_HPSC
	bool "SD_MODE_HPSC"

config SD_MODE_HPSC1
	bool "SD_MODE_HPSC1"

config NAND_MODE_HPSC
	bool "NAND_MODE_HPSC"

config EMMC_MODE_HPSC
	bool "EMMC_MODE_HPSC"

config USB_MODE_HPSC
	bool "USB"

config SW_USBHOST_MODE_HPSC
	bool "SW USBHOST_MODE"

config SW_SATA_MODE_HPSC
	bool "SW SATA_MODE"

config SD1_LSHFT_MODE_HPSC
	bool "SD1_LSHFT_MODE_HPSC"

endchoice

endif
```

## arch/arm/mach-hpsc-hpps/Kconfig
```kconfig
# SPDX-License-Identifier: GPL-2.0

if ARCH_HPSC_HPPS

config SYS_BOARD
	default "hpps"

config SYS_VENDOR
	string "Vendor name"
	default "hpsc"

config SYS_SOC
	default "hpps"

config SYS_CONFIG_NAME
	string "Board configuration name"
	default "hpsc_hpps"
	help
	  This option contains information about board configuration name.
	  Based on this option include/configs/<CONFIG_SYS_CONFIG_NAME>.h header
	  will be used for board configuration.

config SYS_MALLOC_F_LEN
	default 0x600

endif
```

## arch/arm/mach-rtps-r52/Kconfig
```kconfig
# SPDX-License-Identifier: GPL-2.0

if ARCH_HPSC_RTPS_R52

config SYS_BOARD
	string "Board name"
	default "rtps_r52"

config SYS_VENDOR
	string "Vendor name"
	default "hpsc"

config SYS_SOC
	default "rtps-r52"

config SYS_CONFIG_NAME
	string "Board configuration name"
	default "hpsc_rtps_r52"
	help
	  This option contains information about board configuration name.
	  Based on this option include/configs/<CONFIG_SYS_CONFIG_NAME>.h header
	  will be used for board configuration.

config SYS_MALLOC_F_LEN
	default 0x600

endif
```

## configs/hpsc_hpps_defconfig
```kconfig
CONFIG_ARM=y
CONFIG_ARM64=y
CONFIG_ARCH_HPSC_HPPS=y

CONFIG_IDENT_STRING=" HPSC HPPS "
CONFIG_SYS_PROMPT="HPPS> "
CONFIG_DEFAULT_DEVICE_TREE="hpsc-hpps"

CONFIG_SYS_TEXT_BASE=0x80020000

CONFIG_USE_BOOTCOMMAND=y
CONFIG_BOOTCOMMAND="run $memboot"
CONFIG_BOOTDELAY=0

CONFIG_SYS_NS16550=y
CONFIG_DEBUG_UART=y
CONFIG_DEBUG_UART_NS16550=y
CONFIG_DEBUG_UART_BASE=0xF92C0000
CONFIG_DEBUG_UART_CLOCK=16000000
CONFIG_BAUDRATE=500000

CONFIG_HUSH_PARSER=y
CONFIG_OF_SEPARATE=y

CONFIG_ENV_IS_IN_NVRAM=y
CONFIG_ENV_ADDR=0x8005f000
CONFIG_ENV_SIZE=0x1000

# CONFIG_DISPLAY_CPUINFO is not set
# CONFIG_CMD_XIMG is not set
# CONFIG_CMD_BOOTEFI is not set
# CONFIG_NET is not set
# CONFIG_SYS_MALLOC_CLEAR_ON_INIT is not set
```

## configs/hpsc_rtps_a53_defconfig
```kconfig
CONFIG_ARM=y
CONFIG_ARM64=y
CONFIG_ARCH_HPSC_RTPS_A53=y

CONFIG_IDENT_STRING=" HPSC RTPS A53"
CONFIG_SYS_PROMPT="RTPS A53> "
CONFIG_DEFAULT_DEVICE_TREE="hpsc-rtps-a53"

CONFIG_SYS_TEXT_BASE=0x60020000

# CONFIG_USE_BOOTCOMMAND is not set

CONFIG_SYS_NS16550=y
CONFIG_DEBUG_UART=y
CONFIG_DEBUG_UART_NS16550=y
CONFIG_DEBUG_UART_BASE=0x30001000
CONFIG_DEBUG_UART_CLOCK=16000000
CONFIG_BAUDRATE=500000

CONFIG_HUSH_PARSER=y
CONFIG_OF_EMBED=y

CONFIG_ENV_IS_IN_NVRAM=y
CONFIG_ENV_ADDR=0x6005f000
CONFIG_ENV_SIZE=0x1000

# CONFIG_DISPLAY_CPUINFO is not set
# CONFIG_CMD_XIMG is not set
# CONFIG_NET is not set
```

## configs/hpsc_rtps_r52_defconfig
```kconfig
CONFIG_ARM=y
CONFIG_ARM64=n
CONFIG_ARCH_HPSC_RTPS_R52=y

CONFIG_IDENT_STRING=" HPSC RTPS R52 "
CONFIG_SYS_PROMPT="RTPS R52> "
CONFIG_DEFAULT_DEVICE_TREE="hpsc-rtps-r52"

CONFIG_SYS_TEXT_BASE=0x40000000

CONFIG_USE_BOOTCOMMAND=y
CONFIG_BOOTCOMMAND="bootm 0x40040000"

CONFIG_SYS_NS16550=y
CONFIG_DEBUG_UART_NS16550=y
CONFIG_DEBUG_UART_BASE=0x30001000
CONFIG_DEBUG_UART_CLOCK=16000000
CONFIG_DEBUG_UART=y
CONFIG_BAUDRATE=500000

CONFIG_OF_EMBED=y

CONFIG_ENV_IS_IN_NVRAM=y
CONFIG_ENV_ADDR=0x4003f000
CONFIG_ENV_SIZE=0x1000

CONFIG_SYS_ARCH_TIMER=y

CONFIG_DISPLAY_CPUINFO=n
CONFIG_CMD_XIMG=n
CONFIG_CMD_BOOTEFI=n
CONFIG_EFI_LOADER=n
CONFIG_NET=n
```
